## config/west.yml
```yaml
manifest:
  remotes:
    #- name: zmkfirmware
    #  url-base: https://github.com/zmkfirmware
    #- name: infused-kim
    #  url-base: https://github.com/infused-kim
      - name: urob
      url-base: https://github.com/urob
  projects:
    - name: zmk
      #remote: zmkfirmware
      remote: urob
      revision: main
      #remote: infused-kim
      #revision: sofle
      import: app/west.yml
  self:
    path: config
```
